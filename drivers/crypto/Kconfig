## drivers/crypto/Kconfig
```kconfig
source "drivers/crypto/Kconfig.opentitan_aes"

# https://github.com/zephyrproject-rtos/zephyr/blob/main/drivers/crypto/Kconfig
```

## drivers/crypto/Kconfig.opentitan_aes
```kconfig
# Copyright (c) 2026 Bana Tawalbeh
# SPDX-License-Identifier: Apache-2.0

config CRYPTO_OPENTITAN_AES
	bool "OpenTitan AES driver"
	default y
	depends on DT_HAS_LOWRISC_OPENTITAN_AES_ENABLED
	select CRYPTO
	help
	  Enable this option to use OpenTitan AES hardware accelerator

config CRYPTO_OPENTITAN_AES_RENODE_COMPAT
	bool "Renode key length encoding workaround"
	default n
	help
	  Use Renode's non-standard KEY_LEN encoding. This is only for
	  simulation in Renode. Real OpenTitan hardware uses one-hot values.


config CRYPTO_OPENTITAN_MAX_SESSION
	int "Maximum number of concurrent sessions"
	default 2
	help
	  This determines the number of pre-allocated session structures 
	  available in RAM.




# https://github.com/zephyrproject-rtos/example-application/blob/main/drivers/blink/Kconfig.gpio_led
# subsystem - vendor - IP:    CRYPTO_OPENTITAN_AES
```

## dts/bindings/crypto/lowrisc,opentitan-aes.yaml
```yaml
# Copyright (c) 2026, Bana Tawalbeh
# SPDX-License-Identifier: Apache-2.0

description: OpenTitan AES Hardware Accelerator

compatible: "lowrisc,opentitan-aes"

include: [base.yaml]

# properties:
#   interrupts:
#     required: false

# https://github.com/zephyrproject-rtos/zephyr/blob/main/dts/bindings/crypto/bflb%2Csec-eng-aes.yaml
# https://github.com/zephyrproject-rtos/zephyr/blob/main/dts/bindings/crypto/silabs%2Csi32-aes.yaml
```
